## conf/bblayers.conf.sample
```bitbake
# LAYER_CONF_VERSION is increased each time build/conf/bblayers.conf
# changes incompatibly
LCONF_VERSION = "7"

BBPATH = "${TOPDIR}"
BBFILES ?= ""
BASE = "${TOPDIR}/../"

BBLAYERS ?= " \
${BASE}/openembedded-core/meta \
${BASE}/meta-openembedded/meta-oe \
${BASE}/meta-openembedded/meta-python \
${BASE}/meta-openembedded/meta-multimedia \
${BASE}/meta-ros \
"
```
